## buildroot/packages/Config.in
```kconfig
source "$BR2_EXTERNAL/dk_leds/Config.in"
source "$BR2_EXTERNAL/led_player/Config.in"
```

## buildroot/packages/dk_leds/Config.in
```kconfig
config BR2_PACKAGE_DK_LEDS
        bool "DK_LEDS"
        help
          This is a comment that explains what libfoo is.
```

## buildroot/packages/led_player/Config.in
```kconfig
config BR2_PACKAGE_LED_PLAYER
        select BR2_PACKAGE_DK_LEDS
        bool "led-player"
        help
          This is a comment that explains what libfoo is.
```
